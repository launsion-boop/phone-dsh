## firmware/components/pdsh_home/Kconfig
```kconfig
menu "PDSH Home HTTP"
config XL_HOME_BRIDGE
    bool
    default y
    select ESP_HTTP_CLIENT_ENABLE_CUSTOM_TRANSPORT
    select ESP_HTTP_CLIENT_ENABLE_HTTPS
    select LWIP_SO_LINGER
config PDSH_HOME_ORIGIN
    string "Allowed home origin (exact private IPv4 and port, empty disables home.http)"
    default ""
    help
        Example http://192.168.1.50:8123. No DNS or redirects are allowed.
endmenu
```

## firmware/esp32-reference/main/Kconfig.projbuild
```kconfig
menu "PDSH reference board"
config PDSH_WIFI_SSID
    string "Wi-Fi SSID (empty disables Wi-Fi)"
    default ""
config PDSH_WIFI_PASSWORD
    string "Wi-Fi password"
    default ""
config PDSH_LED_GPIO
    int "Discrete LED GPIO (-1 disables light.set)"
    range -1 48
    default -1
config PDSH_BUTTON_GPIO
    int "Button GPIO, active low (-1 disables button events)"
    range -1 48
    default 0
config PDSH_INDICATOR_GPIO
    int "Enrollment indicator GPIO, active high (-1: enrollment cannot be armed)"
    range -1 48
    default -1
    help
        Dedicated output that shows enrollment mode (1 Hz armed, 4 Hz waiting
        for the confirm hold). It must not be the light.* LED or the button;
        without it the board never arms and begin/revoke/identity-reset answer
        controls_unavailable (ble-secure-session.md 3.3).
endmenu
```
